.global asignar_nota
.global Polling
.global Suena_Buzzer     
    
.data
do_IMG: .byte 0x00, 0x00, 0xff, 0xff, 0xff, 0xff, 0xff, 0xff, 0x81, 0xff, 0x63, 0xdd, 0xdd,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 0x00
re_IMG: .byte 0x00, 0x00, 0xff, 0xff, 0xff, 0xff, 0xff, 0xff, 0x81, 0xff, 0x63, 0xdd, 0xdd,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 0x00
mi_IMG: .byte 0x00, 0x00, 0xff, 0xff, 0xff, 0xff, 0xff, 0xff, 0x81, 0xff, 0x63, 0xdd, 0xdd,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 0x00
fa_IMG: .byte 0x00, 0x00, 0xff, 0xff, 0xff, 0xff, 0xff, 0xff, 0x81, 0xff, 0x63, 0xdd, 0xdd,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 0x00
sol_IMG: .byte 0x00, 0x00, 0xff, 0xff, 0xff, 0xff, 0xff, 0xff, 0x81, 0xff, 0x63, 0xdd, 0xdd,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 0x00
la_IMG: .byte 0x00, 0x00, 0xff, 0xff, 0xff, 0xff, 0xff, 0xff, 0x81, 0xff, 0x63, 0xdd, 0xdd,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 0x00
si_IMG: .byte 0x80, 0xfa, 0xfa, 0xfa, 0xfa, 0xfa, 0xfa, 0xfa, 0xfa, 0xfa, 0xfa, 0xfa, 0xfa,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 0x00 
do_st_IMG: .byte 0x00, 0x00, 0xff, 0xff, 0xff, 0xff, 0xff, 0xff, 0x81, 0xff, 0x63, 0xdd, 0xdd,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 0x00
re_st_IMG: .byte 0x00, 0x00, 0xff, 0xff, 0xff, 0xff, 0xff, 0xff, 0x81, 0xff, 0x63, 0xdd, 0xdd,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 0x00 
fa_st_IMG: .byte 0x00, 0x00, 0xff, 0xff, 0xff, 0xff, 0xff, 0xff, 0x81, 0xff, 0x63, 0xdd, 0xdd,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 0x00 
sol_st_IMG: .byte 0x00, 0x00, 0xff, 0xff, 0xff, 0xff, 0xff, 0xff, 0x81, 0xff, 0x63, 0xdd, 0xdd,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 0x00
la_st_IMG: .byte 0x00, 0x00, 0xff, 0xff, 0xff, 0xff, 0xff, 0xff, 0x81, 0xff, 0x63, 0xdd, 0xdd,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 0x00
     
    
.text

# $a0 contiene un registro con los pines no relevantes forzados a 0 del PORTB  
# Devuelve en $v0 la nota en formato comando    
recibir_nota_btn:
    
	# Hago mascaras para determinar la opcion que se esta haciendo
	# menu
	li $t1, 0x02000
	and $t2, $a0, $t1
	li $t3, 0x0
	bne $t2, $zero,  fin

	# do
	li $t1, 0x01000
	and $t2, $a0, $t1
	li $t3, 97
	bnez $t2, fin

	# re
	li $t1, 0x0800
	and $t2, $a0, $t1
	li $t3, 115
	bnez $t2, fin

	# mi
	li $t1, 0x0400
	and $t2, $a0, $t1
	li $t3, 100
	bnez $t2, fin

	# fa
	li $t1, 0x0200
	and $t2, $a0, $t1
	li $t3, 102
	bnez $t2, fin

	# sol
	li $t1, 0x0100
	and $t2, $a0, $t1
	li $t3, 103
	bnez $t2, fin

	# la
	li $t1, 0x4000
	and $t2, $a0, $t1
	li $t3, 104
	bnez $t2, fin

	# si
	li $t1, 0x8000
	and $t2, $a0, $t1
	li $t3, 106
	bnez $t2, fin

	# do sostenido
	li $t1, 0x020
	and $t2, $a0, $t1
	li $t3, 119
	bnez $t2, fin

	# re sostenido
	li $t1, 0x010
	and $t2, $a0, $t1
	li $t3, 101
	bnez $t2, fin

	# fa sostenido
	li $t1, 0x08
	and $t2, $a0, $t1
	li $t3, 116
	bnez $t2, fin

	# sol sostenido
	li $t1, 0x04
	and $t2, $a0, $t1
	li $t3, 121
	bnez $t2, fin

	# la sostenido
	li $t1, 0x02
	and $t2, $a0, $t1
	li $t3, 117
	bnez $t2, fin

	# no devuelvo nada
	jr $ra

	# devuelvo el valor que tenga cargado en $t3 anteriormente
	fin:
	move $v0, $t3
	
jr $ra
    
   
    
# $a0 -> recibe la nota 
# $v0 imagen nota, $v1 divisor frecuencia nota
asignar_nota:
    
    
	beq $a0, 'a', nota_do		# DO
	beq $a0, 's', nota_re		# RE
	beq $a0, 'd', nota_mi		# MI
	beq $a0, 'f', nota_fa		# FA
	beq $a0, 'g', nota_sol		# SOL
	beq $a0, 'h', nota_la		# LA
	beq $a0, 'j', nota_si		# SI
	beq $a0, 'w', nota_do_st	# DO sostenido
	beq $a0, 'e', nota_re_st	# RE sostenido
	beq $a0, 't', nota_fa_st	# FA sostenido
	beq $a0, 'y', nota_sol_st	# SOL sostenido
	beq $a0, 'u', nota_la_st	# LA sostenido

	nota_do:
	la $a1, do_IMG
	li $t1, 1910
	j fin_nota

	nota_re:
	la $a1, re_IMG
	li $t1, 1701
	j fin_nota

	nota_mi:
	la $a1, mi_IMG
	li $t1, 1515
	j fin_nota

	nota_fa:
	la $a1, fa_IMG
	li $t1, 1430
	j fin_nota

	nota_sol:
	la $a1, sol_IMG
	li $t1, 1274
	j fin_nota

	nota_la:
	la $a1, la_IMG
	li $t1, 1135
	j fin_nota

	nota_si:
	la $a1, si_IMG
	li $t1, 1011
	j fin_nota

	nota_do_st:
	la $a1, do_st_IMG
	li $t1, 1802
	j fin_nota

	nota_re_st:
	la $a1, re_st_IMG
	li $t1, 1606
	j fin_nota

	nota_fa_st:
	la $a1, fa_st_IMG
	li $t1, 1350
	j fin_nota

	nota_sol_st:
	la $a1, sol_st_IMG
	li $t1, 1202
	j fin_nota

	nota_la_st:
	la $a1, la_st_IMG
	li $t1, 1071
	j fin_nota

	fin_nota: 
	move $v0, $a1
	move $v1, $t1
	
	
jr $ra

    # Recibe en $a0 lo que llego por UART
recibir_UART:
    

	move $t1, $a0

	# checkeo si se recibio informaicon
	beq $t1, 'a', recibe_nota   # DO
	beq $t1, 's', recibe_nota   # RE
	beq $t1, 'd', recibe_nota   # MI
	beq $t1, 'f', recibe_nota   # FA
	beq $t1, 'g', recibe_nota   # SOL
	beq $t1, 'h', recibe_nota   # LA
	beq $t1, 'j', recibe_nota   # SI
	beq $t1, 'w', recibe_nota	# DO sostenido
	beq $t1, 'e', recibe_nota	# RE sostenido
	beq $t1, 't', recibe_nota	# FA sostenido
	beq $t1, 'y', recibe_nota	# SOL sostenido
	beq $t1, 'u', recibe_nota	# LA sostenido


	li $v0, 1  # si no recibio dato acorde, devuelvo dato 0 equivalente a MENU
	jr $ra

	recibe_nota:
	move $v0, $t1
	
	
jr $ra



Polling: # $v0, nota seleccionada formato comando Polling()
	
    
	addi $sp, $sp, -4
	sw $ra, 0($sp)
	
	loop_Polling:
	lw $t0, U1STA
	andi $t0, $t0, 1
	bnez $t0, dato_UART
	
	lw $t0, PORTB
	li $t1, 0xFF3E
	and $t2, $t0, $t1
	beqz $t2, loop_Polling
	move $a0, $t2
	j Dato_PORTB

	
	dato_UART:
     # Llego dato
	lw $t1, U1RXREG
	
	checkeo_envio_UART:
	lw $t0, U1STA
	andi $t0, $t0, 0x100
	beqz $t0, checkeo_envio_UART

	# Llegado este punto, ya se que puedo mandar sin sobreescribir
	sw $t1, U1TXREG    
	
	move $a0, $t1
	jal recibir_UART

	
	lw $ra, 0($sp)
	addi $sp, $sp, 4

	jr $ra

	Dato_PORTB:
    
	jal recibir_nota_btn
	# devuelve en $v0 la nota que leyo

	lw $ra, 0($sp)
	addi $sp, $sp, 4

jr $ra

    
Suena_Buzzer: # void Suena_Buzzer(a0, valor PR2 asociado a la nota)
    
    addi $sp, $sp, -4
    sw $ra, ($sp)
    
	move $t0, $a0
	sw $t0, PR2 # Cargo periodo

	addiu $t0, $t0, 1
	divu $t0, $t0, 2
	sw $t0, OC2RS # Duty Cycle 50%

	sw $t0, OC2R # Duty Cycle inicial 50%

	li $t1, 0x6
	sw $t1, OC2CON # Op PWM

	li $t1, 0x8000
	sw $t1, OC2CONSET # PWM ON
	
	li $t1, 0x8000
	sw $t1, T2CON # Timer ON

	lw $t0, TMR2
	li $t3, 10
	
	jal delay_buzzer


	li $t1, 0x8000
	sw $t1, OC2CONCLR # PWM OFF

	 li $t1, 0x8000
	sw $t1, T2CONCLR  # Timer OFF

	li $t1, 0
	sw $t1, TMR2 # Timer en 0
    
	lw $ra, ($sp)
	addi $sp, $sp, 4
	
jr $ra
    
delay_buzzer:
    
	li $t0, 30000     
	loop_buzzer_delay:
	addi $t0, $t0, -1
	bnez $t0, loop_buzzer_delay

jr $ra 
    
	
	
